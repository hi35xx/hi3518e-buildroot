## configs/hi3518_defconfig
```kconfig
BR2_arm=y
BR2_TOOLCHAIN_EXTERNAL=y
BR2_TOOLCHAIN_EXTERNAL_GDB_SERVER_COPY=y
BR2_TARGET_GENERIC_ISSUE="Welcome to IPCAM"
BR2_ROOTFS_DEVICE_CREATION_DYNAMIC_MDEV=y
# BR2_TARGET_GENERIC_REMOUNT_ROOTFS_RW is not set
BR2_ROOTFS_USERS_TABLES="board/hisilicon/hi3518/users-table.txt"
BR2_ROOTFS_OVERLAY="board/hisilicon/hi3518/rootfs-overlay"
BR2_LINUX_KERNEL=y
BR2_LINUX_KERNEL_CUSTOM_LOCAL=y
BR2_LINUX_KERNEL_CUSTOM_LOCAL_PATH="linux/linux-3.0.y"
BR2_LINUX_KERNEL_USE_CUSTOM_CONFIG=y
BR2_LINUX_KERNEL_CUSTOM_CONFIG_FILE="board/hisilicon/hi3518/linux-3.0.config"
BR2_PACKAGE_BUSYBOX_CONFIG="board/hisilicon/hi3518/busybox.config"
BR2_PACKAGE_SDL=y
# BR2_PACKAGE_SDL_FBCON is not set
BR2_PACKAGE_SDL_TTF=y
BR2_PACKAGE_DBUS=y
BR2_PACKAGE_DBUS_CPP=y
BR2_PACKAGE_DBUS_TRIGGERD=y
BR2_PACKAGE_HIMPP=y
BR2_PACKAGE_HIMPP_SAMPLES=y
BR2_PACKAGE_HIMPP_SNS_SONY_IMX122=y
BR2_PACKAGE_HIMPP_SAMPLES_REGION=y
BR2_PACKAGE_HIMPP_SAMPLES_VENC=y
BR2_PACKAGE_UBOOT_TOOLS=y
BR2_PACKAGE_LUAJIT=y
BR2_PACKAGE_WSAPI_FCGI=y
BR2_PACKAGE_NGINX=y
BR2_PACKAGE_NGINX_FILE_AIO=y
BR2_PACKAGE_NGINX_HTTP_SSL_MODULE=y
BR2_PACKAGE_NGINX_HTTP_AUTH_REQUEST_MODULE=y
BR2_TARGET_ROOTFS_SQUASHFS=y
BR2_TARGET_ROOTFS_SQUASHFS4_XZ=y
BR2_TARGET_ROOTFS_TAR_XZ=y
```

## configs/hi3518e_defconfig
```kconfig
BR2_arm=y
BR2_KERNEL_HEADERS_3_10=y
BR2_TOOLCHAIN_BUILDROOT_LARGEFILE=y
BR2_TOOLCHAIN_BUILDROOT_INET_IPV6=y
BR2_TOOLCHAIN_BUILDROOT_INET_RPC=y
BR2_TOOLCHAIN_BUILDROOT_LOCALE=y
BR2_PTHREAD_DEBUG=y
BR2_TOOLCHAIN_BUILDROOT_USE_SSP=y
BR2_GCC_VERSION_4_5_X=y
BR2_TOOLCHAIN_BUILDROOT_CXX=y
BR2_PACKAGE_HOST_GDB=y
BR2_GDB_VERSION_7_8=y
BR2_ENABLE_LOCALE_PURGE=y
BR2_ENABLE_LOCALE_WHITELIST="C en_US zh_CN zh_TW"
BR2_TARGET_GENERIC_HOSTNAME="ipcam"
BR2_ROOTFS_DEVICE_CREATION_DYNAMIC_MDEV=y
BR2_LINUX_KERNEL=y
BR2_LINUX_KERNEL_CUSTOM_LOCAL=y
BR2_LINUX_KERNEL_CUSTOM_LOCAL_PATH="linux/linux-3.0.y"
BR2_LINUX_KERNEL_USE_CUSTOM_CONFIG=y
BR2_LINUX_KERNEL_CUSTOM_CONFIG_FILE="board/hisilicon/hi3518e/linux-3.0.config"
BR2_PACKAGE_BUSYBOX_CONFIG="board/hisilicon/hi3518e/busybox.config"
BR2_PACKAGE_GDB=y
BR2_PACKAGE_GSOAP=y
BR2_PACKAGE_EXFAT=y
BR2_PACKAGE_EXFAT_UTILS=y
BR2_PACKAGE_DBUS=y
BR2_PACKAGE_DBUS_CPP=y
BR2_PACKAGE_MT7601U=y
BR2_PACKAGE_UBOOT_TOOLS=y
BR2_PACKAGE_FREETYPE=y
BR2_PACKAGE_LIVE555=y
# BR2_PACKAGE_LIVE555_OPENRTSP is not set
# BR2_PACKAGE_LIVE555_MPEG2_INDEXER is not set
BR2_PACKAGE_NGINX=y
BR2_PACKAGE_NGINX_HTTP_SSL_MODULE=y
BR2_PACKAGE_WIRELESS_REGDB=y
BR2_PACKAGE_WIRELESS_TOOLS=y
BR2_PACKAGE_WIRELESS_TOOLS_LIB=y
BR2_PACKAGE_WPA_SUPPLICANT=y
BR2_PACKAGE_WPA_SUPPLICANT_AP_SUPPORT=y
BR2_PACKAGE_WPA_SUPPLICANT_EAP=y
BR2_PACKAGE_WPA_SUPPLICANT_HOTSPOT=y
BR2_PACKAGE_WPA_SUPPLICANT_DEBUG_SYSLOG=y
BR2_PACKAGE_WPA_SUPPLICANT_WPS=y
BR2_PACKAGE_WPA_SUPPLICANT_CLI=y
BR2_PACKAGE_WPA_SUPPLICANT_PASSPHRASE=y
BR2_PACKAGE_WPA_SUPPLICANT_DBUS_NEW=y
BR2_PACKAGE_WPA_SUPPLICANT_DBUS_INTROSPECTION=y
BR2_TARGET_ROOTFS_CPIO=y
BR2_TARGET_ROOTFS_CPIO_XZ=y
BR2_TARGET_ROOTFS_SQUASHFS=y
BR2_TARGET_ROOTFS_SQUASHFS4_XZ=y
BR2_TARGET_ROOTFS_TAR_XZ=y
BR2_TARGET_UBOOT=y
BR2_TARGET_UBOOT_BOARDNAME="hi3518e"
BR2_TARGET_UBOOT_CUSTOM_LOCAL=y
BR2_TARGET_UBOOT_CUSTOM_LOCAL_PATH="boot/uboot/u-boot-2010.06"
```

## package/himpp/himpp-hi3518/Config.in
```kconfig
comment "Options for hi3518 mpp2"

config BR2_PACKAGE_HIMPP_PREFIX
	string "prefix"
	default "/opt/himpp2"
	help
	  Prefix to install himpp2 on the target file system.

menuconfig BR2_PACKAGE_HIMPP_SAMPLES
	bool "build mpp2 samples"
	default n
	depends on BR2_PACKAGE_HIMPP_HI3518
	help
	  Build samples for HiMPP2 for HI3518

if BR2_PACKAGE_HIMPP_SAMPLES

choice
	bool "sensor type"
	default BR2_PACKAGE_HIMPP_SNS_OMNI_OV9712
	help
	  Sensor type for hi3518

config BR2_PACKAGE_HIMPP_SNS_APTINA_AR0130
	bool "Aptina ar0130"
	help
	  Aptina ar0130

config BR2_PACKAGE_HIMPP_SNS_APTINA_AR0330
	bool "Aptina ar0330"
	help
	  Aptina ar0330

config BR2_PACKAGE_HIMPP_SNS_APTINA_9M034
	bool "Aptina 9m034"
	help
	  Aptina 9m034

config BR2_PACKAGE_HIMPP_SNS_HIMAX_1375
	bool "Himax 1375"
	help
	  Himax 1375

config BR2_PACKAGE_HIMPP_SNS_OMNI_OV2710
	bool "Omni ov2710"
	help
	  Omni ov2710

config BR2_PACKAGE_HIMPP_SNS_OMNI_OV9712
	bool "Omni ov9712"
	help
	  Omni ov9712

config BR2_PACKAGE_HIMPP_SNS_PANASONIC_MN34031
	bool "Panasonic mn34031"
	help
	  Panasonic mn34031

config BR2_PACKAGE_HIMPP_SNS_PIXELPLUS_3100K
	bool "PixelPlus 3100k"
	help
	  PixelPlus 3100k

config BR2_PACKAGE_HIMPP_SNS_SOI_H22
	bool "SOI H22"
	help
	  SOI H22

config BR2_PACKAGE_HIMPP_SNS_SONY_ICX692
	bool "Sony icx692"
	help
	  Sony icx692

config BR2_PACKAGE_HIMPP_SNS_SONY_IMX104
	bool "Sony imx104"
	help
	  Sony imx104

config BR2_PACKAGE_HIMPP_SNS_SONY_IMX122
	bool "Sony imx122"
	help
	  Sony imx122

config BR2_PACKAGE_HIMPP_SNS_SONY_IMX138
	bool "Sony imx138"
	help
	  Sony imx138

config BR2_PACKAGE_HIMPP_SNS_SONY_IMX236
	bool "Sony imx236"
	help
	  Sony imx236

endchoice

config BR2_PACKAGE_HIMPP_SNS_TYPE
	string
	default APTINA_AR0130_DC_720P_30FPS if BR2_PACKAGE_HIMPP_SNS_APTINA_AR0130
	default APTINA_AR0330_DC_1080P_30FPS if BR2_PACKAGE_HIMPP_SNS_APTINA_AR0330
	default APTINA_9M034_DC_720P_30FPS if BR2_PACKAGE_HIMPP_SNS_APTINA_9M034
	default HIMAX_1375_DC_720P_30FPS if BR2_PACKAGE_HIMPP_SNS_HIMAX_1375
	default OMNI_OV9712_DC_720P_30FPS if BR2_PACKAGE_HIMPP_SNS_OMNI_OV9712
	default OMNI_OV2710_DC_1080P_30FPS if BR2_PACKAGE_HIMPP_SNS_OMNI_OV2710
	default PANASONIC_MN34031_DC_720P_30FPS if BR2_PACKAGE_HIMPP_SNS_PANASONIC_MN34031
	default PIXELPLUS_3100K_DC_720P_30FPS if BR2_PACKAGE_HIMPP_SNS_PIXELPLUS_3100K
	default SOI_H22_DC_720P_30FPS if BR2_PACKAGE_HIMPP_SNS_SOI_H22
	default SONY_ICX692_DC_720P_30FPS if BR2_PACKAGE_HIMPP_SNS_SONY_ICX692
	default SONY_IMX104_DC_720P_30FPS if BR2_PACKAGE_HIMPP_SNS_SONY_IMX104
	default SONY_IMX122_DC_1080P_30FPS if BR2_PACKAGE_HIMPP_SNS_SONY_IMX122
	default SONY_IMX138_DC_720P_30FPS if BR2_PACKAGE_HIMPP_SNS_SONY_IMX138
	default SONY_IMX236_DC_1080P_30FPS if BR2_PACKAGE_HIMPP_SNS_SONY_IMX236

config BR2_PACKAGE_HIMPP_SAMPLES_AUDIO
	bool "audio"
	depends on BR2_PACKAGE_HIMPP_SAMPLES
	help
	  Build audio samples for hi3518

config BR2_PACKAGE_HIMPP_SAMPLES_HIFB
	bool "hifb"
	depends on BR2_PACKAGE_HIMPP_SAMPLES
	help
	  Build hifb samples for hi3518

config BR2_PACKAGE_HIMPP_SAMPLES_IQ
	bool "iq"
	depends on BR2_PACKAGE_HIMPP_SAMPLES
	help
	  Build iq samples for hi3518

config BR2_PACKAGE_HIMPP_SAMPLES_IVE
	bool "ive"
	depends on BR2_PACKAGE_HIMPP_SAMPLES
	help
	  Build ive samples for hi3518

config BR2_PACKAGE_HIMPP_SAMPLES_REGION
	bool "region"
	depends on BR2_PACKAGE_HIMPP_SAMPLES
	help
	  Build region samples for hi3518

config BR2_PACKAGE_HIMPP_SAMPLES_TDE
	bool "tde"
	depends on BR2_PACKAGE_HIMPP_SAMPLES
	help
	  Build tde samples for hi3518

config BR2_PACKAGE_HIMPP_SAMPLES_VDA
	bool "vda"
	depends on BR2_PACKAGE_HIMPP_SAMPLES
	help
	  Build vda samples for hi3518

config BR2_PACKAGE_HIMPP_SAMPLES_VENC
	bool "venc"
	depends on BR2_PACKAGE_HIMPP_SAMPLES
	help
	  Build venc samples for hi3518

config BR2_PACKAGE_HIMPP_SAMPLES_VIO
	bool "vio"
	depends on BR2_PACKAGE_HIMPP_SAMPLES
	help
	  Build vio samples for hi3518

endif #BR2_PACKAGE_HIMPP_SAMPLES
```

## package/mt7601u/Config.in
```kconfig
comment "mt7601u needs a Linux kernel to be built"
	depends on !BR2_LINUX_KERNEL

config BR2_PACKAGE_MT7601U
	depends on BR2_LINUX_KERNEL
	bool "mt7601u"
	help
	  USB Wireless driver for MediaTek mt7601u chip
```
